## examples/ESP-IDF/01_I2C_Test/main/Kconfig.projbuild
```kconfig
menu "Example Configuration"

    config EXAMPLE_I2C_MASTER_SCL
        int "SCL GPIO Num"
        default 19 if IDF_TARGET_ESP32
        default 4
        help
            GPIO number for I2C Master clock line.

    config EXAMPLE_I2C_MASTER_SDA
        int "SDA GPIO Num"
        default 18 if IDF_TARGET_ESP32
        default 5
        help
            GPIO number for I2C Master data line.

endmenu
```

## examples/ESP-IDF/03_SD_Test/sdkconfig.defaults
```kconfig
CONFIG_IDF_TARGET="esp32s3"
CONFIG_ESP_DEFAULT_CPU_FREQ_MHZ_240=y
CONFIG_ESPTOOLPY_FLASHMODE_QIO=y
CONFIG_ESPTOOLPY_FLASHFREQ_80M=y
CONFIG_ESPTOOLPY_FLASHSIZE_16MB=y
CONFIG_SPIRAM_MODE_OCT=y
CONFIG_IDF_EXPERIMENTAL_FEATURES=y
CONFIG_SPIRAM_SPEED_80M=y
CONFIG_SPIRAM_FETCH_INSTRUCTIONS=y
CONFIG_SPIRAM_RODATA=y
CONFIG_ESP_CONSOLE_USB_SERIAL_JTAG=y

CONFIG_EXAMPLE_PIN_MOSI=11
CONFIG_EXAMPLE_PIN_MISO=13
CONFIG_EXAMPLE_PIN_CLK=12
CONFIG_EXAMPLE_PIN_CS=-1

CONFIG_I2C_MASTER_SCL=9
CONFIG_I2C_MASTER_SDA=8
```
